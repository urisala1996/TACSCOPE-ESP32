## sdkconfig.defaults
```kconfig
CONFIG_IDF_TARGET="esp32c3"

# 4 MB flash, custom partition table with a 3 MB app slot
CONFIG_ESPTOOLPY_FLASHSIZE_4MB=y
CONFIG_PARTITION_TABLE_CUSTOM=y
CONFIG_PARTITION_TABLE_CUSTOM_FILENAME="partitions.csv"

# Performance
CONFIG_COMPILER_OPTIMIZATION_PERF=y
CONFIG_ESP_MAIN_TASK_STACK_SIZE=6144

# TLS: only common CAs in the bundle (saves flash; adsb.lol uses Let's Encrypt)
CONFIG_MBEDTLS_CERTIFICATE_BUNDLE=y
CONFIG_MBEDTLS_CERTIFICATE_BUNDLE_DEFAULT_CMN=y
```
